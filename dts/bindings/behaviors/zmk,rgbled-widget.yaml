## dts/bindings/behaviors/zmk,rgbled-widget.yaml
```yaml
# zmk,rgbled-widget.yaml
description: RGB LED widget indicator behavior

compatible: "zmk,behavior-rgbled-widget"

include: zero_param.yaml

properties:
  indicate-battery:
    type: boolean
  indicate-connectivity:
    type: boolean
  indicate-layer:
    type: boolean
  # 添加PWM相关属性（可选）
  pwm-leds:
    type: phandle-array
    required: false
```
